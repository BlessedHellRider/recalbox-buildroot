## package/zeldaroth/Config.in
```kconfig
config BR2_PACKAGE_ZELDAROTH
        bool "zeldaroth"
	depends on BR2_INSTALL_LIBSTDCPP
	select BR2_PACKAGE_SDL
	select BR2_PACKAGE_SDL_GFX
	select BR2_PACKAGE_SDL_IMAGE
	select BR2_PACKAGE_SDL_MIXER
        help
          Zelda fangame
	  http://www.zeldaroth.fr/

	comment "Zelda Roth"
```

## package/zeldasolarusdx/Config.in
```kconfig
config BR2_PACKAGE_ZELDASOLARUSDX
        bool "zeldasolarusdx"
	select BR2_PACKAGE_SOLARUS
        help
          Zelda fangame created with the Solarus engine
	  https://github.com/christopho/zsdx/

comment "Zelda Solarus DX needs Solarus Engine"
```

## package/zeldasolarusxd/Config.in
```kconfig
config BR2_PACKAGE_ZELDASOLARUSXD
        bool "zeldasolarusxd"
	select BR2_PACKAGE_SOLARUS
        help
          Zelda fangame created with the Solarus engine
	  https://github.com/christopho/zsxd/

comment "Zelda Solarus XD needs Solarus Engine"
```
